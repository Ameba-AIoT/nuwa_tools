#include "project_km4/platform_autoconf.h"
/* constant macro */
#define KBYTES(x)  					((x) * 1024)
#define IMAGE_HEADER_LEN			(0x20)

/* layout configuration */
#define TZ_NSC_SIZE 	 			(4)
#define TZ_ENTRY_SIZE 				(16)
#define TZ_S_SIZE 					(1024)

#define PSRAM_BASE					(0x02000000)
#define PSRAM_END					(PSRAM_BASE + KBYTES(4*1024)) /* 4MB PSRAM */

#if defined(CONFIG_TRUSTZONE)
#define RAM_TZ_NSC_SIZE 	 		KBYTES(TZ_NSC_SIZE)
#define RAM_TZ_ENTRY_SIZE 			KBYTES(TZ_ENTRY_SIZE)
#define PSRAM_KM4_IMG3_SIZE 		KBYTES(TZ_S_SIZE)
#else
#define RAM_TZ_NSC_SIZE 	 		KBYTES(0)
#define RAM_TZ_ENTRY_SIZE 			KBYTES(0)
#define PSRAM_KM4_IMG3_SIZE 		KBYTES(0)
#endif

#define KM4_BD_RAM_NSC_START		(0x1007C000 - RAM_TZ_NSC_SIZE)
#define KM4_BD_RAM_S_START			(KM4_BD_RAM_NSC_START - RAM_TZ_ENTRY_SIZE)
#define KM4_PSRAM_S_START			(PSRAM_END - PSRAM_KM4_IMG3_SIZE)

MEMORY
{
	/* KM0 ROM */
	KM0_IROM (rx) :					ORIGIN = 0x00000000, LENGTH = 0x00018000 - 0x00000000	/* KM0 IROM: 96k */
	KM0_DROM (rx) :                 ORIGIN = 0x00020000, LENGTH = 0x00024000 - 0x00020000 	/* KM0 DROM: 16k */

	/* KM4 ROM */
	KM4_IROM (rx) :                 ORIGIN = 0x10100000, LENGTH = 0x1010A000 - 0x10100000	/* KM4 IROM_S: 40k */
	KM4_IROM_NS (rx) :              ORIGIN = 0x1010A000, LENGTH = 0x10140000 - 0x1010A000	/* KM4 IROM_NS: 216k */
	KM4_DROM_NS (rx) :              ORIGIN = 0x101C0000, LENGTH = 0x101D4000 - 0x101C0000	/* KM4 DROM_NS: 80k */
	KM4_DROM (rx) :                 ORIGIN = 0x101D4000, LENGTH = 0x101D8000 - 0x101D4000	/* KM4 DROM_S: 16k */

	/* KM0 RAM */
	KM0_ROMBSS_RAM (rw) :           ORIGIN = 0x00080000, LENGTH = 0x00081000 - 0x00080000	/* KM0 ROM BSS RAM: 4K */
	KM0_TIMER_IDLE_TASK_STACK (rw) : ORIGIN = 0x00081000, LENGTH = 0x00082000 - 0x00081000	/* KM0 TIMER and IDLE task stack: 4k */
	KM0_BOOTLOADER_RAM (rwx) :      ORIGIN = 0x00082000, LENGTH = 0x00083000 - 0x00082000	/* KM0 BOOT Loader RAM: 4K */
	KM0_FLOADER_RAM (rwx) :         ORIGIN = 0x00082000, LENGTH = 0x0008F000 - 0x00082000	/* KM0 ImgTool Flash Loader RAM: 52K */
	KM0_BD_RAM (rwx) :              ORIGIN = 0x00083000, LENGTH = 0x0008F000 - 0x00083000	/* KM0 MAIN RAM: 48K */
	KM0_MSP_RAM (wx) :              ORIGIN = 0x0008F000, LENGTH = 0x00090000 - 0x0008F000 	/* KM0 MSP RAM: 4k */

	/* Retention RAM */
	RETENTION_RAM (rwx) :           ORIGIN = 0x000C0000, LENGTH = 0x000C0400 - 0x000C0000	/* Retention RAM: 1K */

	/* Non-secure PSRAM */
	KM4_PSRAM_NS (rwx) :            ORIGIN = 0x02000020, LENGTH = KM4_PSRAM_S_START - 0x02000020	/* KM4 PSRAM NS: 3M */
	KM4_PSRAM_S (rwx) :             ORIGIN = KM4_PSRAM_S_START, LENGTH = PSRAM_KM4_IMG3_SIZE	/* KM4 PSRAM_S: 1M */

	/* KM4 Non-secure RAM */
	KM4_ROMBSS_RAM_COM (rw) :       ORIGIN = 0x10000000, LENGTH = 0x10001000 - 0x10000000	/* KM4 ROM BSS COMMON(S & NS both used) RAM: 4k */
	KM4_ROMBSS_RAM_NS (rw) :        ORIGIN = 0x10001000, LENGTH = 0x10002000 - 0x10001000	/* KM4 ROM BSS NS RAM: 4k */
	KM4_MSP_RAM_NS (rw) :           ORIGIN = 0x10002000, LENGTH = 0x10003000 - 0x10002000	/* KM4 MSP_NS RAM: 4K */
	KM4_BD_RAM_NS (rwx) :           ORIGIN = 0x10003000, LENGTH = KM4_BD_RAM_S_START - 0x10003000	/* KM4 MAIN RAM NS: 464K or 484k */
	KM4_BD_RAM_S (rwx) :            ORIGIN = KM4_BD_RAM_S_START, LENGTH = RAM_TZ_ENTRY_SIZE	/* KM4 MAIN RAM S: 16K */
	KM4_BD_RAM_NSC (rwx) :          ORIGIN = KM4_BD_RAM_NSC_START, LENGTH = RAM_TZ_NSC_SIZE	/* KM4 MAIN RAM NSC: 4K */

	/* KM4 Secure RAM  */
	KM4_ROMBSS_RAM_S (rw) :         ORIGIN = 0x1007C000, LENGTH = 0x1007D000 - 0x1007C000	/* KM4 ROM BSS RAM S: 4k */
	KM4_BOOTLOADER_RAM_S (rwx) :    ORIGIN = 0x1007D000, LENGTH = 0x1007EC00 - 0x1007D000	/* KM4 BOOT Loader RAM: 7k */
	KM4_MSP_RAM_S (rw) :            ORIGIN = 0x1007EC00, LENGTH = 0x1007F000 - 0x1007EC00	/* KM4 MSP_S RAM: 1k (sboot use 4k before img1 load) */
	KM4_TIMER_IDLE_TASK_STACK (rw) : ORIGIN = 0x1007F000, LENGTH = 0x10080000 - 0x1007F000	/* KM4 TIMER and IDLE task stack: 4k */

	KM4_EXTENTION_SRAM (rwx) :      ORIGIN = 0x100E0000, LENGTH = 0x10100000 - 0x100E0000	/* KM4 EXTENTION SRAM: 128k */

	/* Flash */
	KM0_BOOT_XIP (rx) :             ORIGIN = 0x08000020, LENGTH = 0x08004000 - 0x08000020	/* KM0 XIP BOOT: 16k, 32 Bytes for header*/
	KM4_BOOT_XIP (rx) :             ORIGIN = 0x08004020, LENGTH = 0x08014000 - 0x08004020	/* KM4 XIP BOOT: 64k, 32 Bytes for header*/
	KM0_IMG2_XIP (rx) :             ORIGIN = 0x0C000020, LENGTH = 0x0E000000 - 0x0C000020	/* KM0 IMG2 Virtual address: 32768k */
	KM4_IMG2_XIP (rx) :             ORIGIN = 0x0E000020, LENGTH = 0x10000000 - 0x0E000020	/* KM4 IMG2 Virtual address: 32768k */
	BTRACE (rx) :                   ORIGIN = 0x00800000, LENGTH = 0x00C00000 -0x00800000	/* Bluetooth Trace */
}

__ls_flash_text_start__ = ORIGIN(KM0_IMG2_XIP);
__hs_flash_text_start__ = ORIGIN(KM4_IMG2_XIP);
